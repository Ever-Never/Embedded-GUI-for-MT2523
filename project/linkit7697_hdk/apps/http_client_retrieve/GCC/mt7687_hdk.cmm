
;
; This CMM is for lakrpsur development on 7697 E2 EVB. 
;
;
;


SYStem.RESet
SYStem.JtagClock 5MHz
SYStem.cpu CortexM4
SYStem.CONFIG SWDP ON
SYStem.Attach

break

; === Flash Range Setup ===

CFlash.Base 0x10000000
CFlash.Size 0x00200000

; unlock SWD
D.S D:0x8300F050 %LE %LONG 0x76371688
D.S D:0x8300F050 %LE %LONG 0x76371688
D.S D:0x8300F050 %LE %LONG 0x76371688

; === Load symbol, does not download to RAM ===
DATA.LOAD.ELF V:\geneva_git\gva\out\mt7697_xip.elf /nocode 


y.spath kernel/rtos/FreeRTOS/Source/
y.spath driver/chip/mt7687/src/
y.spath project/linkit7697_hdk/apps/iot_sdk/

d.l

